## component/bluetooth/Kconfig.inic
```kconfig
# set this to 'y' to debug BT inic without WiFi WHC
config BT_INIC_DEBUG
    depends on (!WHC_DEV_MENU && !WHC_HOST_MENU)
    bool
    default n

# set this to 'y' to debug BT inic host without WiFi WHC
config BT_INIC_HOST_DEBUG
    depends on (!WHC_DEV_MENU && !WHC_HOST_MENU)
    bool
    default n

choice
    depends on AMEBAGREEN2 && (WHC_DEV_MENU || BT_INIC_DEBUG)
    prompt "Chip Select"
    default BT_AMEBAGREEN2_FW
    config BT_AMEBAGREEN2_FW
        bool "AmebaGreen2"
    config BT_RTL8851F_FW
        bool "RTL8851F"
endchoice

choice
    depends on (WHC_DEV_MENU || BT_INIC_DEBUG || WHC_HOST_MENU || BT_INIC_HOST_DEBUG)
    prompt "HW Interface"
    default BT_INIC_SHARE
    config BT_INIC_SHARE
        depends on (WHC_DEV_MENU || WHC_HOST_MENU)
        bool "Share interface with WiFi"
    config BT_INIC_H4
        bool "UART H4"
    config BT_INIC_H5
        bool "UART H5"
    config BT_INIC_NONE
        bool "Internal"
    config BT_INIC_SPI_D
        depends on (BT_INIC_DEBUG || BT_INIC_HOST_DEBUG)
        bool "SPI"
    config BT_INIC_SDIO_D
        depends on (BT_INIC_DEBUG || BT_INIC_HOST_DEBUG)
        bool "SDIO"
    config BT_INIC_USB_D
        depends on AMEBAGREEN2 && (BT_INIC_DEBUG || BT_INIC_HOST_DEBUG)
        bool "USB"
endchoice

if AMEBAGREEN2 && BT_INIC_H4
config BT_INIC_H4_TX_PIN
    int "H4 UART0 TX pin (PA=0, PB=32, PC=64)"
    range 0 95
    default 4

config BT_INIC_H4_RX_PIN
    int "H4 UART0 RX pin (PA=0, PB=32, PC=64)"
    range 0 95
    default 5

config BT_INIC_H4_CTS_PIN
    int "H4 UART0 CTS pin (PA=0, PB=32, PC=64)"
    range 0 95
    default 6

config BT_INIC_H4_RTS_PIN
    int "H4 UART0 RTS pin (PA=0, PB=32, PC=64)"
    range 0 95
    default 7
endif

config BT_INIC_SPI
    def_bool (BT_INIC_SHARE && WHC_INTF_SPI) || BT_INIC_SPI_D

config BT_INIC_SDIO
    def_bool (BT_INIC_SHARE && WHC_INTF_SPDIO) || BT_INIC_SDIO_D

config BT_INIC_USB
    def_bool (BT_INIC_SHARE && WHC_INTF_USB) || BT_INIC_USB_D

config BT_INIC_USB_SW_ENABLE
    bool "Expose USB Bluetooth interfaces without the NIC OTP enable bit"
    depends on AMEBAGREEN2 && BT_INIC_USB && WHC_DEV_FLASH_BOOT
    default n
    help
        Enable the USB Bluetooth descriptors on flash-boot development boards
        whose NIC-mode BT_FUNCTION_EN OTP flag is unset. The Bluetooth HCI
        controller is still initialized by the firmware on the first command.
        This only changes the runtime USB descriptor configuration; it does
        not program OTP. Enable only on boards with Bluetooth hardware.

config BT_INIC
    def_bool (WHC_DEV_MENU && !BT_INIC_NONE) || BT_INIC_DEBUG

config BT_INIC_HOST
    def_bool WHC_HOST_MENU || BT_INIC_HOST_DEBUG
```

## component/wifi/whc/whc_host_linux/configs/amebagreen2_usb_nan_bulk2048_defconfig
```kconfig
CONFIG_WHC_HCI_USB=y
CONFIG_AMEBAGREEN2=y
CONFIG_WHC_CMD_PATH=y
CONFIG_WHC_WIFI_API_PATH=y
CONFIG_NAN=y
# CONFIG_FW_DOWNLOAD is not set
CONFIG_WHC_USB_BULK_2048=y
```
